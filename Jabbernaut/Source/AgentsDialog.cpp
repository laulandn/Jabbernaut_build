///--------------------------------------------------------------------------------------
//	File:		AgentsDialog.cpp
//	Project:	Jabbernaut
//
//	Purpose:	<default>
//	Created:	Wednesday, 2000-05-17
//	Authors:	MH - Max Horn <max@quendi.de>
//
//	Copyright:	(c) 2000-2001 Max Horn <max@quendi.de>
//
//	This program is free software; you can redistribute it and/or modify
//	it under the terms of the GNU General Public License as published by
//	the Free Software Foundation; either version 2 of the License, or
//	(at your option) any later version.
//	
//	This program is distributed in the hope that it will be useful,
//	but WITHOUT ANY WARRANTY; without even the implied warranty of
//	MERCHANTABILITY or FITNESS FOR A PARTICULAR PURPOSE.  See the
//	GNU General Public License for more details.
//	
//	You should have received a copy of the GNU General Public License
//	along with this program; if not, write to the Free Software
//	Foundation, Inc., 675 Mass Ave, Cambridge, MA 02139, USA, or visit
//	<http://www.gnu.org/copyleft/gpl.html> on the World Wide Web.
///--------------------------------------------------------------------------------------


///- Includes ---------------------------------------------------------------------------
#pragma mark === Includes ===

#include	"MacZoop.h"
#include	"ZListDialogItem.h"

#include	"AgentsDialog.h"
#include	"AgentsManager.h"
#include	"ConnectionManager.h"
#include	"JabberApplication.h"

#include	"Messages.h"

#include	<string>
#include	<typeinfo>


///- Contants ---------------------------------------------------------------------------
#pragma mark -
#pragma mark === Contants ===

enum
{
	kAgentsDialogID	= 1010
};

enum
{
	kAgentsListID		= 1,
	
	kAgentsAddBtnID		= 2,
	kAgentsRefreshBtnID	= 3
};


#pragma mark -
#pragma mark [Class Init]


///--------------------------------------------------------------------------------------
//	¥ Constructor:
///--------------------------------------------------------------------------------------
AgentsDialog::AgentsDialog( ZCommander* aBoss, const short windowID )
	: inherited( aBoss, windowID )
{
	isInline = true;

	mZHL = NULL;
}


///--------------------------------------------------------------------------------------
//	¥ Constructor:
///--------------------------------------------------------------------------------------
AgentsDialog::AgentsDialog()
	: inherited( gApplication, kAgentsDialogID )
{
	isInline = true;

	mZHL = NULL;
}


///--------------------------------------------------------------------------------------
//	¥ Destructor:
///--------------------------------------------------------------------------------------
AgentsDialog::~AgentsDialog()
{
	AgentsManager::msAgentsDialog = NULL;
}


#pragma mark -


///--------------------------------------------------------------------------------------
//	ClickItem:
//		Handle mouse clicks inside of the dialog
//		
//	Changes:
//		2000-10-16	MH		Created
///--------------------------------------------------------------------------------------
void	AgentsDialog::ClickItem( const short theItem )
{
	inherited::ClickItem( theItem );
	
	switch( theItem )
	{
	case kAgentsAddBtnID:
		// Open a dialog to add a server to the server list...
		SysBeep( 1 );
		break;
	
	case kAgentsRefreshBtnID:
		AgentsManager::RefreshAgentList();
		// FIX ME - show spinning arrows or so
		break;
	};
}


///--------------------------------------------------------------------------------------
//	UpdateMenus:
//		update the menu to enable our command as appropriate
//		
//	Changes:
//		2000-08-02	MH		Created
///--------------------------------------------------------------------------------------
void		AgentsDialog::UpdateMenus()
{
	inherited::UpdateMenus();

	if( mZHL && ConnectionManager::IsLoggedIn() )
	{
		if( mZHL->TotalSelected() == 1 )
		{
			if( typeid(*mZHL->GetSelection(1)) == typeid(ZHLAgentItem) )
			{
				gMenuBar->EnableCommand( kCmdInformation );
			}
		}
	}
}


///--------------------------------------------------------------------------------------
//	HandleCommand:
//		Handle commands
//		
//	Changes:
//		2000-08-02	MH		Created
///--------------------------------------------------------------------------------------
void		AgentsDialog::HandleCommand( const ZoopCommand aCmd )
{
	switch ( aCmd )
	{
		case kCmdInformation:
			if( mZHL->TotalSelected() == 1 )
			{
				ZHLAgentItem		*zhlAI = NULL;
				zhlAI = dynamic_cast<ZHLAgentItem *>(mZHL->GetSelection( 1 ));
			
				if( zhlAI )
					zhlAI->DoEditAgentItem();
			}
			break;

		default:
			inherited::HandleCommand( aCmd );
			break;
	}
}


///--------------------------------------------------------------------------------------
//	ReceiveMessage:
//		
//		
//	Changes:
//		2000-05-27	MH		Created
///--------------------------------------------------------------------------------------
void	AgentsDialog::ReceiveMessage( ZComrade* aSender, ZoopMessage aMsg, UntypedPtr msgData )
{
//	msgListItemDoubleClicked
}


///--------------------------------------------------------------------------------------
//	ContextualMenuClick:
//		pass on contextual click to the ZHL
//		
//	Changes:
//		2000-08-02	MH		Created
///--------------------------------------------------------------------------------------
void	AgentsDialog::ContextualMenuClick( Point globalMouse )
{
	if( mZHL )
	{
		if( this != gApplication->GetFrontWindow() )
			Select();
		mZHL->ContextualMenuClick( globalMouse );
	}
}


#pragma mark -


///--------------------------------------------------------------------------------------
//	UserInitialise:
//		set up the ZHL in here
//		
//	Changes:
//		2000-08-02	MH		Created
///--------------------------------------------------------------------------------------
void	AgentsDialog::UserInitialise( ZDialogItem* theItem )
{
	ZHLDialogItem	*zhlItem = dynamic_cast<ZHLDialogItem *>(theItem);
	
	if( zhlItem )
	{
		mZHL = zhlItem;
		mZHL->SetModes( zhl::selOnlyOne | zhl::selNotContents );
	}
}
