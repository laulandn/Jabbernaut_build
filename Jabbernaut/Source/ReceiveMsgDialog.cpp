///--------------------------------------------------------------------------------------
//	File:		ReceiveMsgDialog.cpp
//	Project:	Jabbernaut
//
//	Purpose:	Handle incoming (normal) messages
//	Created:	Saturday, 2000-04-22
//	Authors:	MH - Max Horn <max@quendi.de>
//
//	Copyright:	(c) 2000-2001 Max Horn <max@quendi.de>
//
//	This program is free software; you can redistribute it and/or modify
//	it under the terms of the GNU General Public License as published by
//	the Free Software Foundation; either version 2 of the License, or
//	(at your option) any later version.
//	
//	This program is distributed in the hope that it will be useful,
//	but WITHOUT ANY WARRANTY; without even the implied warranty of
//	MERCHANTABILITY or FITNESS FOR A PARTICULAR PURPOSE.  See the
//	GNU General Public License for more details.
//	
//	You should have received a copy of the GNU General Public License
//	along with this program; if not, write to the Free Software
//	Foundation, Inc., 675 Mass Ave, Cambridge, MA 02139, USA, or visit
//	<http://www.gnu.org/copyleft/gpl.html> on the World Wide Web.
///--------------------------------------------------------------------------------------


///- Includes ---------------------------------------------------------------------------
#pragma mark === Includes ===

#include	"MacZoop.h"
#include	"ZDialogItem.h"

#include	"JabberApplication.h"
#include	"Profile.h"
#include	"ReceiveMsgDialog.h"
#include	"RosterManager.h"
#include	"SendManager.h"
#include	"SendMsgDialog.h"

#include	"MacJLibUtils.h"
#include	"CTCPUtils.h"
#include	"MessageMsg.h"

#include	<typeinfo>
#include	<stdlib.h>
#include	<string.h>


using namespace MacJLib;

///- Constants --------------------------------------------------------------------------
#pragma mark -
#pragma mark === Constants ===

const	int kReceiveMessageDialogID	= 1002;

enum
{
#ifdef TOQ
	kReceiveMsgReplyBtnID		= 1,
	kReceiveMsgMessageID		= 2
#else
	kReceiveMsgNextBtnID		= 1,
	kReceiveMsgAddToRosterBtnID	= 2,
	kReceiveMsgReplyBtnID		= 3,
	kReceiveMsgSenderID			= 7,
	kReceiveMsgSubjectID		= 9,
	kReceiveMsgTimeID			= 11,
	kReceiveMsgMessageID		= 12
#endif
};


#pragma mark -
#pragma mark [Class Init]


///--------------------------------------------------------------------------------------
//	е Constructor:
///--------------------------------------------------------------------------------------
ReceiveMsgDialog::ReceiveMsgDialog( const MessageMsg &aMsg )
	: inherited( gApplication, kReceiveMessageDialogID )
{
	mMsgQueue.push( new MacJLib::MessageMsg(aMsg) );
	mSenderJID = aMsg.getFrom();
}


///--------------------------------------------------------------------------------------
//	е Destructor:
///--------------------------------------------------------------------------------------
ReceiveMsgDialog::~ReceiveMsgDialog()
{
	while( !mMsgQueue.empty() )
	{
		delete mMsgQueue.front();
		mMsgQueue.pop();
	}
}


#pragma mark -


///--------------------------------------------------------------------------------------
//	InitZWindow:
//		Display the first message
//		
//	Changes:
//		2000-10-06	MH		Created
///--------------------------------------------------------------------------------------
void	ReceiveMsgDialog::InitZWindow()
{
	inherited::InitZWindow();
	
	DisplayMessage( *mMsgQueue.front() );
#ifndef TOQ
	GetItemObject( kReceiveMsgNextBtnID )->Disable( TRUE );

	if( RosterManager::IsOnRoster( mSenderJID ) && (mSenderJID != Profile::GetOurJID()) )
		HideItem( kReceiveMsgAddToRosterBtnID );
#endif
}


///--------------------------------------------------------------------------------------
//	ClickItem:
//		Handle clicks on the dialog items.
//		
//	Changes:
//		2000-04-22	MH		Created
///--------------------------------------------------------------------------------------
void	ReceiveMsgDialog::ClickItem( const short theItem )
{
	inherited::ClickItem( theItem );
#ifndef TOQ
	if( theItem == kReceiveMsgNextBtnID )
	{
		DisplayNextMessage();
	}
	else if( theItem == kReceiveMsgAddToRosterBtnID )
	{
		if( !RosterManager::IsOnRoster( mSenderJID ) && (mSenderJID != Profile::GetOurJID())  )
			RosterManager::DoAddRosterItem( mSenderJID );
	}
	else
#endif
	if( theItem == kReceiveMsgReplyBtnID )
	{
		HandleCommand( kCmdReplyToMessage );
	}
}


///--------------------------------------------------------------------------------------
//	UpdateMenus:
//		Enable the reply command if appropriate
//		
//	Changes:
//		2000-08-02	MH		Created
///--------------------------------------------------------------------------------------
void	ReceiveMsgDialog::UpdateMenus()
{
	inherited::UpdateMenus();
	
	if( !mMsgQueue.empty() )
		gMenuBar->EnableCommand( kCmdReplyToMessage );
}


///--------------------------------------------------------------------------------------
//	HandleCommand:
//		Handle the reply command
//		
//	Changes:
//		2000-08-02	MH		Created
///--------------------------------------------------------------------------------------
void	ReceiveMsgDialog::HandleCommand( const ZoopCommand aCmd )
{
	if( aCmd == kCmdReplyToMessage && !mMsgQueue.empty() )
	{
		// open new 'Send Message' dialog based on mCurMsg
		SendManager::DoReply( this, mMsgQueue.front()->getFrom(), mMsgQueue.front()->getThread(), mMsgQueue.front()->getSubject());

#ifdef TOQ
// FIX ME
		// now close this dialog
		Close( kRunning );
#endif
	}
	else
		inherited::HandleCommand( aCmd );
}


#pragma mark -


///--------------------------------------------------------------------------------------
//	OnMessage:
//		OnMessage is called by the static method DispatchMessageMsg
//		
//	Changes:
//		2000-05-10	MH		Created
///--------------------------------------------------------------------------------------
void	ReceiveMsgDialog::OnMessage( const MacJLib::MessageMsg &aMsg )
{
	MacJLib::MessageMsg *localCopyOfMsg;
	
	FailNIL( localCopyOfMsg = new MacJLib::MessageMsg(aMsg) );
	
	mMsgQueue.push( localCopyOfMsg );
	
#ifndef TOQ
	GetItemObject( kReceiveMsgNextBtnID )->Enable( TRUE );
#endif
	
}


///--------------------------------------------------------------------------------------
//	DisplayNextMessage:
//		Get the newest message and display it in the dialog (this does not show the dialog
//		if it's hidden)
//		
//	Changes:
//		2000-04-22	MH		Created
///--------------------------------------------------------------------------------------
void	ReceiveMsgDialog::DisplayNextMessage()
{
	if( mMsgQueue.size() < 2 )
		return;
	
	delete mMsgQueue.front();
	mMsgQueue.pop();

	DisplayMessage( *mMsgQueue.front() );
	
	CleverSelect();
	
#ifndef TOQ
	if( mMsgQueue.size() < 2 )
		GetItemObject( kReceiveMsgNextBtnID )->Disable( TRUE );
#endif
}


///--------------------------------------------------------------------------------------
//	DisplayMessage:
//		Displays a MessageMsg
//		
//	Changes:
//		2000-10-06	MH		Created
///--------------------------------------------------------------------------------------
void	ReceiveMsgDialog::DisplayMessage( const MessageMsg &aMsg )
{
#ifdef TOQ
	Str255			pStr;
	char			cStr[256];
	std::string		titleStr;

	// Set the window title to display the sender of the message.
	GetName( pStr );
	CopyPToCString( pStr, cStr );
	titleStr = std::string(cStr) + RosterManager::GetRosterNick( aMsg.getFrom() );
	CopyCToPString( titleStr.c_str(), pStr );
	SetTitle( pStr );
#else
	std::time_t		secs;
	
	// show the sender
	SetValueAsString( kReceiveMsgSenderID, RosterManager::CompleteJID( aMsg.getFrom() ) );
	
	// show the subject
	SetValueAsString( kReceiveMsgSubjectID, aMsg.getSubject() );
	
	// show the time
	secs = aMsg.getTimeStamp() + MacJLib::TimeZoneOffsetInSeconds();
	SetValueAsString( kReceiveMsgTimeID, BuildTimeString(secs) );
#endif
	
	// and finally the message body
	SetValueAsString( kReceiveMsgMessageID, aMsg.getBody() );
}


#pragma mark -


///--------------------------------------------------------------------------------------
//	HasRemainingMessages:
//		HasRemainingMessages returns true when mMsgQueue is not empty.
//		
//	Changes:
//		2000-05-10	MH		Created
///--------------------------------------------------------------------------------------
bool	ReceiveMsgDialog::HasRemainingMessages()
{
	return	!mMsgQueue.empty();
}

