///--------------------------------------------------------------------------------------
//	File:		ZHLAgentItem.cpp
//	Project:	Jabbernaut
//
//	Purpose:	A ZHL (folder) tem that is used to display&store an agent item
//	Created:	Wednesday, 2000-08-02
//	Authors:	MH - Max Horn <max@quendi.de>
//
//	Copyright:	(c) 2000-2001 Max Horn <max@quendi.de>
//
//	This program is free software; you can redistribute it and/or modify
//	it under the terms of the GNU General Public License as published by
//	the Free Software Foundation; either version 2 of the License, or
//	(at your option) any later version.
//	
//	This program is distributed in the hope that it will be useful,
//	but WITHOUT ANY WARRANTY; without even the implied warranty of
//	MERCHANTABILITY or FITNESS FOR A PARTICULAR PURPOSE.  See the
//	GNU General Public License for more details.
//	
//	You should have received a copy of the GNU General Public License
//	along with this program; if not, write to the Free Software
//	Foundation, Inc., 675 Mass Ave, Cambridge, MA 02139, USA, or visit
//	<http://www.gnu.org/copyleft/gpl.html> on the World Wide Web.
///--------------------------------------------------------------------------------------


///- Includes ---------------------------------------------------------------------------
#pragma mark === Includes ===

#include	"MacZoop.h"

#include	"AgentEditDialog.h"
#include	"ConnectionManager.h"
#include	"RosterManager.h"
#include	"ZHLAgentItem.h"

#include	"Messages.h"


///- Globals ----------------------------------------------------------------------------
#pragma mark -
#pragma mark === Globals ===


///- Static Globals ---------------------------------------------------------------------
#pragma mark -
#pragma mark === Static Globals ===


///- Prototypes -------------------------------------------------------------------------
#pragma mark -
#pragma mark === Prototypes ===


#pragma mark -
#pragma mark [Class Init]


///--------------------------------------------------------------------------------------
//	е Constructor:
///--------------------------------------------------------------------------------------
ZHLAgentItem::ZHLAgentItem()
	: ZHLFolder("\pAgentItem"),
	 mGroupchat(false), mRegisterable(false), mSearchable(false), mRegistered(false)
{
	// at the beginning, we have no sub-agents, so don't draw any!
	isFolder = false;
	
	mEditDialog = NULL;
}


///--------------------------------------------------------------------------------------
//	е Destructor:
///--------------------------------------------------------------------------------------
ZHLAgentItem::~ZHLAgentItem()
{
	if( mEditDialog )
	{
		mEditDialog->Close( gApplication->GetPhase() );
		mEditDialog = NULL;
	}
}


#pragma mark -


///--------------------------------------------------------------------------------------
//	OnAgent:
//		handle changes to this item
//		(caller has to make sure we are the right target, i.e. JID matches)
//		
//	Changes:
//		2000-08-02	MH		Created
///--------------------------------------------------------------------------------------
void	ZHLAgentItem::OnAgent( const Agent &inAgent )
{
	//
	// 1) Copy the information provided in inAgent
	//
	mJID = inAgent.getJID();
	mName = inAgent.getName();
	mDescription = inAgent.getDescription();
	mTransport = inAgent.getTransport();
	mService = inAgent.getService();
	mGroupchat = inAgent.isGroupChat();
	mRegisterable = inAgent.isRegisterable();
	mSearchable = inAgent.isSearchable();
	
#if 0
// disabled; this code slows down things to a crawl, and it really isn't of much use,
// as many agents are buggy and don't send back a <registered/> flag
	//
	// 2) Send a register request so we can get the key and learn if the user is registered
	//
	MacJLib::RegisterMsg	*anRegisterMsg;

	FailNIL( anRegisterMsg = new MacJLib::RegisterMsg() );
	anRegisterMsg->setType( "get" );
	anRegisterMsg->setTo( mJID );
	ConnectionManager::PostMessage( anRegisterMsg );
#endif

	//
	// 3) Check if this agent has sub-agents, and if yes, then query for them
	//
	isFolder = inAgent.hasSubAgents();
	if( isFolder )
	{
		MacJLib::AgentsMsg	*anAgentsMsg;

		FailNIL( anAgentsMsg = new MacJLib::AgentsMsg() );
		anAgentsMsg->setType( "get" );
		anAgentsMsg->setTo( mJID );
		ConnectionManager::PostMessage( anAgentsMsg );
	}
	
	//
	// 4) Inform the RosterManager so it can managet the agents meta group properly
	//
	RosterManager::CheckMetaGroups();
}


///--------------------------------------------------------------------------------------
//	OnRegister:
//		handle changes to this item
//		(caller has to make sure we are the right target, i.e. JID matches)
//		
//	Changes:
//		2000-08-02	MH		Created
///--------------------------------------------------------------------------------------
void	ZHLAgentItem::OnRegister( const RegisterMsg &inRegister )
{
	//if( aMsg.getType() == "result" )

	setRegistered( inRegister.isRegistered() );
}


///--------------------------------------------------------------------------------------
//	DoEditAgentItem:
//		Open an edit dialog for this agent
//		
//	Changes:
//		2000-11-08	MH		Created
///--------------------------------------------------------------------------------------
void	ZHLAgentItem::DoEditAgentItem()
{
	if( !mEditDialog )
	{
		FailNIL( mEditDialog = new AgentEditDialog(this) );

		try
		{
			mEditDialog->InitZWindow();
			mEditDialog->Place();
		}
		catch( ZoopError err )
		{
			ForgetObject( mEditDialog );
			
			throw err;
		}
	}
	else
		mEditDialog->SyncWithZHLAgentItem();

	mEditDialog->Select();
}


#pragma mark -


///--------------------------------------------------------------------------------------
//	DrawCell:
//		Draw the list cell.
//		
//	Changes:
//		2000-08-02	MH		Created
///--------------------------------------------------------------------------------------
void	ZHLAgentItem::DrawCell( Rect& r, ZHLDialogItem *boss )
{
	short		height, relTop;
	Str255		pStr;
	
	height = r.bottom - r.top;			// height of cell
	relTop = 1 + (height * 2) / 3;		// top offset for text
	
	MoveTo( r.left, r.top + relTop );
	CopyCToPString( getDisplayString().c_str(), pStr );
	if( isFolder )
		TextFace(bold);
	DrawString( pStr );
}


///--------------------------------------------------------------------------------------
//	DoubleClick:
//		Handle a doubleclick on an agent
//		
//	Changes:
//		2000-08-02	MH		Created
///--------------------------------------------------------------------------------------
void	ZHLAgentItem::DoubleClick(short modifiers, ZHLDialogItem *boss)
{
	DoEditAgentItem();
}


///--------------------------------------------------------------------------------------
//	ContextualMenuClick:
//		Contextual menu handler
//		
//	Changes:
//		2000-08-02	MH		Created
///--------------------------------------------------------------------------------------
void	ZHLAgentItem::ContextualMenuClick (const Point where)
{
}


#pragma mark -


std::string		ZHLAgentItem::getDisplayString() const
{
	return std::string(mName + " (" + mJID.getFull() + ")");
}


void	ZHLAgentItem::setRegistered( bool reg )
{
	mRegistered = reg;
	if( mEditDialog )
		mEditDialog->SyncWithZHLAgentItem();
}


#pragma mark -


///--------------------------------------------------------------------------------------
//	ZHLAgenttemCompare:
//		Compares two ZHLAgentItems
//		
//	Changes:
//		2000-05-16	MH		Created
///--------------------------------------------------------------------------------------
short	ZHLAgenttemCompare( void *inItemA, void *inItemB, const long ref )
{
	ZHLItem			*itemA, *itemB;
	ZHLAgentItem	*a, *b;
	Str255			aStr, bStr;

	FailNIL( itemA = (*(ZHLItem**)inItemA) );
	FailNIL( itemB = (*(ZHLItem**)inItemB) );
	a = dynamic_cast<ZHLAgentItem *>(itemA);
	b = dynamic_cast<ZHLAgentItem *>(itemB);

	if( a && b )
	{
		// both are ZHLAgentItems -> sort 'em
		CopyCToPString( a->getDisplayString().c_str(), aStr );
		CopyCToPString( b->getDisplayString().c_str(), bStr );
		return RelString(aStr, bStr, false, false);
	}
	else if( a )
		return +1;		// only a is ZHLAgentItem -> b is a folder and goes up
	else if( b )
		return -1;		// only b is ZHLAgentItem -> a is a folder and goes up
	else
		return RelString(itemA->GetNameForSort(), itemB->GetNameForSort(), false, false);
}

