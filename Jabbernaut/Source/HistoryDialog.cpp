///--------------------------------------------------------------------------------------
//	File:		HistoryDialog.cpp
//	Project:	Jabbernaut
//
//	Purpose:	Display the message history
//	Created:	Friday, 2000-06-09
//	Authors:	MH - Max Horn <max@quendi.de>
//
//	Copyright:	(c) 2000-2001 Max Horn <max@quendi.de>
//
//	This program is free software; you can redistribute it and/or modify
//	it under the terms of the GNU General Public License as published by
//	the Free Software Foundation; either version 2 of the License, or
//	(at your option) any later version.
//	
//	This program is distributed in the hope that it will be useful,
//	but WITHOUT ANY WARRANTY; without even the implied warranty of
//	MERCHANTABILITY or FITNESS FOR A PARTICULAR PURPOSE.  See the
//	GNU General Public License for more details.
//	
//	You should have received a copy of the GNU General Public License
//	along with this program; if not, write to the Free Software
//	Foundation, Inc., 675 Mass Ave, Cambridge, MA 02139, USA, or visit
//	<http://www.gnu.org/copyleft/gpl.html> on the World Wide Web.
///--------------------------------------------------------------------------------------


///- Includes ---------------------------------------------------------------------------
#pragma mark === Includes ===

#include	"MacZoop.h"
#include	"ZDialogItem.h"
#include	"ZGrafState.h"
#include	"ZListDialogItem.h"

#include	"HistoryDialog.h"
#include	"HistoryManager.h"
#include	"JabberApplication.h"
#include	"SendManager.h"

#include	"MacJLibUtils.h"
#include	"Messages.h"
#include	"CTCPUtils.h"


///- Constants --------------------------------------------------------------------------
#pragma mark -
#pragma mark === Constants ===

const	int kHistoryDialogID	= 1007;

enum
{
	kMsgHistoryReplyBtnID	= 1,
	kMsgHistoryDeleteBtnID	= 11,
	
	kMsgHistoryListID		= 2,

	kMsgHistoryFromID		= 5,
	kMsgHistorySubjectID	= 7,
	kMsgHistoryTimeID		= 9,

	kMsgHistoryBodyID		= 10
};


#pragma mark -
#pragma mark [Class Init]


///--------------------------------------------------------------------------------------
//	¥ Constructor:
///--------------------------------------------------------------------------------------
HistoryDialog::HistoryDialog( ZCommander* aBoss, const short windowID )
	: inherited( aBoss, kHistoryDialogID )
{
	isInline = true;
	
	mListItem = NULL;
	mCurMsg = NULL;
}


///--------------------------------------------------------------------------------------
//	¥ Constructor:
///--------------------------------------------------------------------------------------
HistoryDialog::HistoryDialog()
	: inherited( gApplication, kHistoryDialogID )
{
	isInline = true;
	
	mListItem = NULL;
	mCurMsg = NULL;
}


///--------------------------------------------------------------------------------------
//	¥ Destructor:
///--------------------------------------------------------------------------------------
HistoryDialog::~HistoryDialog()
{
}


#pragma mark -


///--------------------------------------------------------------------------------------
//	InitZWindow:
//		Initialise this dialog
//		
//	Changes:
//		2000-06-09	MH		Created
///--------------------------------------------------------------------------------------
void	HistoryDialog::InitZWindow()
{
	inherited::InitZWindow();
	
	FailNIL( mListItem = dynamic_cast<ZListDialogItem*>(GetItemObject( kMsgHistoryListID )) );

	HistoryListViewer	*lv;
	FailNIL( lv = new HistoryListViewer() );
	mListItem->MLAttachViewer( lv );
	
	DisplayMessageMsg( NULL );
}


///--------------------------------------------------------------------------------------
//	ClickItem:
//		Handle clicks on the dialog items.
//		
//	Changes:
//		2000-06-09	MH		Created
///--------------------------------------------------------------------------------------
void	HistoryDialog::ClickItem( const short theItem )
{
	ASSERT("mListItem == NULL",mListItem != NULL,0);
	
	Cell	selection = {0,0};
	MessageMsg	*aMsgPtr = NULL;
	mListItem->MLGetSelection( &selection );
	if( selection.v != NO_SELECTION.v )
		aMsgPtr = HistoryManager::msMessageList.at(selection.v);
	
	inherited::ClickItem( theItem );
	
	if( aMsgPtr )
	{
		if( theItem == kMsgHistoryReplyBtnID )
		{
			SendManager::DoReply( NULL, aMsgPtr->getFrom(), aMsgPtr->getThread(), aMsgPtr->getSubject());
		}
		else if( theItem == kMsgHistoryDeleteBtnID )
		{
			// delete selected message (if any) and select the next one
			for(MessageList::iterator X = HistoryManager::msMessageList.begin(); X != HistoryManager::msMessageList.end(); ++X)
			{
				if( *X == aMsgPtr )
				{
					HistoryManager::msMessageList.erase( X );
					break;
				}
			}
			if( mListItem->MLCountRows() > 0 )
			{
				mListItem->MLSetSelection( NO_SELECTION );
				mListItem->MLDeleteRow( 0 );
				if( mListItem->MLCountRows() <= 0 )
					DisplayMessageMsg( NULL );
				else
				{
					short	num = mListItem->MLCountRows()-1;
					if( selection.v > num )
						selection.v = num;
					//mListItem->MLDisableDrawing();
					mListItem->MLSetSelection( selection );
					//mListItem->MLEnableDrawing();
					FailNIL( aMsgPtr = HistoryManager::msMessageList[selection.v] );
					DisplayMessageMsg( aMsgPtr );
				}
			}
		}
	}
}


///--------------------------------------------------------------------------------------
//	ReceiveMessage:
//		
//		
//	Changes:
//		2000-05-27	MH		Created
///--------------------------------------------------------------------------------------
void	HistoryDialog::ReceiveMessage( ZComrade* aSender, ZoopMessage aMsg, UntypedPtr msgData )
{
//	if( aMsg == msgListItemDoubleClicked )
	if( aMsg == msgNewListItemSelected )
	{
		Cell		theCell = *(Cell*)msgData;
		MessageMsg	*aMsgPtr;
		if ( theCell.v >= 0 && theCell.v < HistoryManager::msMessageList.size())
		{
			FailNIL( aMsgPtr = HistoryManager::msMessageList[theCell.v] );
			DisplayMessageMsg( aMsgPtr );
		}
		else
		{
			DisplayMessageMsg( NULL );
		}
	}
}


///--------------------------------------------------------------------------------------
//	UpdateMenus:
//		Enable the reply command if appropriate
//		
//	Changes:
//		2000-08-02	MH		Created
///--------------------------------------------------------------------------------------
void	HistoryDialog::UpdateMenus()
{
	inherited::UpdateMenus();
	
	if( mCurMsg )
		gMenuBar->EnableCommand( kCmdReplyToMessage );
}


///--------------------------------------------------------------------------------------
//	HandleCommand:
//		Handle the reply command
//		
//	Changes:
//		2000-08-02	MH		Created
///--------------------------------------------------------------------------------------
void	HistoryDialog::HandleCommand( const ZoopCommand aCmd )
{
	if( aCmd == kCmdReplyToMessage )
	{
		FakeClick( kMsgHistoryReplyBtnID );
	}
	else
		inherited::HandleCommand( aCmd );
}


#pragma mark -


///--------------------------------------------------------------------------------------
//	OnMessage:
//		Add aMsg to the message history, and add it to the ZListDialogItem
//		
//	Changes:
//		2000-06-09	MH		Created
///--------------------------------------------------------------------------------------
void	HistoryDialog::OnMessage( const MessageMsg &aMsg )
{
	ASSERT("mListItem == NULL",mListItem != NULL,0);
	
	mListItem->MLAppendRow();
}


///--------------------------------------------------------------------------------------
//	DisplayMessageMsg:
//		
//		
//	Changes:
//		2000-06-09	MH		Created
///--------------------------------------------------------------------------------------
void	HistoryDialog::DisplayMessageMsg( MessageMsg *aMsg )
{
	if( aMsg )
	{
		std::time_t		secs = aMsg->getTimeStamp() + MacJLib::TimeZoneOffsetInSeconds();

		SetValueAsString( kMsgHistoryFromID, aMsg->getFrom().getFull() );
		SetValueAsString( kMsgHistorySubjectID, aMsg->getSubject() );
		SetValueAsString( kMsgHistoryTimeID, BuildTimeString( secs ) );
		SetValueAsString( kMsgHistoryBodyID, aMsg->getBody() );
	}
	else
	{
		SetValue( kMsgHistoryFromID, "\p-" );
		SetValue( kMsgHistorySubjectID, "\p-" );
		SetValue( kMsgHistoryTimeID, "\p-" );
#if _DEBUG_
		SetValueAsString( kMsgHistoryBodyID, "This space for rent" );
#else
		SetValueAsString( kMsgHistoryBodyID, "" );
#endif
	}
	mCurMsg = aMsg;
}


#pragma mark -


///--------------------------------------------------------------------------------------
//	DrawCell:
//		
//		
//	Changes:
//		2000-06-09	MH		Created
///--------------------------------------------------------------------------------------

void	HistoryListViewer::DrawCell( Rect* bounds, Cell theCell, Boolean hilited )
{
	Str255		pStr;
	Point       ip;
	FontInfo    fi;

	ZGrafState	zg;
	
	GetListCellIndent( owner->MLGetMacList(), &ip );
	GetFontInfo( &fi );
	
	// use theCell.v to fetch the correct message from the message vector
	MessageMsg	*aMsgPtr = HistoryManager::msMessageList.at(theCell.v);
	
	// Draw sender
	MoveTo( bounds->left + ip.h + 4, bounds->top + fi.ascent );
	CopyCToPString( aMsgPtr->getFrom().c_str(), pStr );
	DrawStringMaxWidth( pStr, 200 );
	
	// Draw subject
	MoveTo( bounds->left + ip.h + 204, bounds->top + fi.ascent );
	CopyCToPString( aMsgPtr->getSubject().c_str(), pStr );
	DrawStringMaxWidth( pStr, 100 );
	
	// Draw time
	MoveTo( bounds->left + ip.h + 304, bounds->top + fi.ascent );
	TimeString( aMsgPtr->getTimeStamp() + MacJLib::TimeZoneOffsetInSeconds(), false, pStr, NULL );
	DrawStringMaxWidth( pStr, 80 );
}

///--------------------------------------------------------------------------------------
//	DrawStringMaxWidth:
//		
//		
//	Changes:
//		2000-06-16	MH		Created
///--------------------------------------------------------------------------------------

void	HistoryListViewer::DrawStringMaxWidth( const Str255 inStr, short maxWidth )
{
	ZGrafState	zg;
	short		width;

	width = StringWidth( inStr );
	
	if( width > maxWidth )
	{
		TextFace( condense );
		width = StringWidth( inStr );
	}
	
	if( width > maxWidth )
	{
		// FIX ME
		// cut off the string if it's too wider
		width = StringWidth( inStr );
	}
	
	DrawString( inStr );
}
